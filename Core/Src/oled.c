/*
 * oled.c
 */

#include "oled.h"
#include "app_config.h"
#include "logging.h"
#include "i2c.h"
#include <stdarg.h>
#include <stdio.h>
#include <string.h>

#if OLED_ENABLED

/* 6x8 ASCII font (32-126), columns left to right, bit 0 = top row.
 * Generated from the X11 koi6x9 bitmap font (public domain), bottom row cropped. */
static const uint8_t FONT6x8[95][6] = {
    {0x00, 0x00, 0x00, 0x00, 0x00, 0x00},  /*   */
    {0x00, 0x00, 0x2F, 0x00, 0x00, 0x00},  /* ! */
    {0x00, 0x07, 0x00, 0x07, 0x00, 0x00},  /* " */
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    {0x00, 0x04, 0x02, 0x04, 0x02, 0x00},  /* ~ */
};

#define OLED_ADDR    (OLED_I2C_ADDR << 1)
#define OLED_PAGES   8
#define OLED_WIDTH   128

static uint8_t fb[OLED_PAGES][OLED_WIDTH];
static uint8_t present = 0;
static uint8_t enabled = 1;
static uint8_t next_page = OLED_PAGES;   /* OLED_PAGES = nothing left to send */

static int cmd(uint8_t c)
{
    return HAL_I2C_Mem_Write(&hi2c1, OLED_ADDR, 0x00, I2C_MEMADD_SIZE_8BIT, &c, 1, 10) == HAL_OK;
}

void Oled_Init(void)
{
    static const uint8_t init_seq[] = {
        0xAE,             /* display off */
        0xD5, 0x80,       /* clock divide */
        0xA8, 0x3F,       /* multiplex 64 */
        0xD3, 0x00,       /* no offset */
        0x40,             /* start line 0 */
        0x8D, 0x14,       /* charge pump on */
        0x20, 0x02,       /* page addressing */
        0xA1, 0xC8,       /* normal for most modules; use 0xA0, 0xC0 if the text is upside down */
        0xDA, 0x12,       /* COM pins for 64 rows */
        0x81, 0x8F,       /* contrast */
        0xD9, 0xF1,       /* pre-charge */
        0xDB, 0x40,       /* VCOMH */
        0xA4, 0xA6,       /* show RAM, normal colours */
        0xAF,             /* display on */
    };

    if (HAL_I2C_IsDeviceReady(&hi2c1, OLED_ADDR, 2, 10) != HAL_OK) {
        LOG_WARN(TAG_DISP, "No OLED at 0x%02X; continuing without display", OLED_I2C_ADDR);
        return;
    }
    for (uint32_t i = 0; i < sizeof(init_seq); i++) {
        if (!cmd(init_seq[i])) {
            LOG_WARN(TAG_DISP, "OLED init failed; continuing without display");
            return;
        }
    }
    present = 1;
    Oled_Clear();
    Oled_Printf(3, 0, "  TinyML thermal");
    Oled_Printf(4, 0, "  starting...");
    Oled_Flush();
    LOG_INFO(TAG_DISP, "OLED found at 0x%02X", OLED_I2C_ADDR);
}

uint8_t Oled_Present(void)  { return present; }
uint8_t Oled_IsEnabled(void) { return present && enabled; }

void Oled_Clear(void)
{
    memset(fb, 0, sizeof(fb));
}

void Oled_Printf(uint8_t line, uint8_t invert, const char *fmt, ...)
{
    char text[OLED_COLS + 1];
    va_list ap;
    if (line >= OLED_LINES) return;
    va_start(ap, fmt);
    vsnprintf(text, sizeof(text), fmt, ap);
    va_end(ap);

    uint8_t *row = fb[line];
    memset(row, invert ? 0xFF : 0x00, OLED_WIDTH);
    for (uint32_t i = 0; text[i] && i < OLED_COLS; i++) {
        char c = text[i];
        if (c < 32 || c > 126) c = '?';
        for (uint32_t x = 0; x < 6; x++) {
            uint8_t col = FONT6x8[c - 32][x];
            row[1 + i * 6 + x] = invert ? (uint8_t)~col : col;
        }
    }
}

void Oled_Flush(void)
{
    if (present && enabled) next_page = 0;
}

void Oled_Service(void)
{
    if (!present || !enabled || next_page >= OLED_PAGES) return;
    uint8_t p = next_page++;
    if (!cmd((uint8_t)(0xB0 | p)) || !cmd(0x00) || !cmd(0x10)) return;
    HAL_I2C_Mem_Write(&hi2c1, OLED_ADDR, 0x40, I2C_MEMADD_SIZE_8BIT, fb[p], OLED_WIDTH, 20);
}

void Oled_Enable(uint8_t on)
{
    if (!present) return;
    enabled = on ? 1 : 0;
    cmd(on ? 0xAF : 0xAE);
    next_page = OLED_PAGES;
}

#else  /* OLED_ENABLED == 0 */

void    Oled_Init(void) {}
uint8_t Oled_Present(void) { return 0; }
uint8_t Oled_IsEnabled(void) { return 0; }
void    Oled_Clear(void) {}
void    Oled_Printf(uint8_t line, uint8_t invert, const char *fmt, ...) { (void)line; (void)invert; (void)fmt; }
void    Oled_Flush(void) {}
void    Oled_Service(void) {}
void    Oled_Enable(uint8_t on) { (void)on; }

#endif /* OLED_ENABLED */
